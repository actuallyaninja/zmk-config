## config/boards/shields/cornergb/Kconfig.shield
```kconfig
# Copyright (c) 2020 Ryan Cross
# SPDX-License-Identifier: MIT

config SHIELD_CORNERGB_LEFT
	def_bool $(shields_list_contains,cornergb_left)

config SHIELD_CORNERGB_RIGHT
	def_bool $(shields_list_contains,cornergb_right)
```

## config/boards/shields/fourier/Kconfig.shield
```kconfig
config SHIELD_FOURIER_LEFT
	def_bool $(shields_list_contains,fourier_left)

config SHIELD_FOURIER_RIGHT
	def_bool $(shields_list_contains,fourier_right)
```

## config/boards/shields/maypadnicenano/Kconfig.defconfig
```kconfig
if SHIELD_MAYPADNICENANO

config ZMK_KEYBOARD_NAME
    default "MayPadnice!nano"

endif
```

## config/boards/shields/maypadnicenano/Kconfig.shield
```kconfig
config SHIELD_MAYPADNICENANO
    def_bool $(shields_list_contains,maypadnicenano)
```

## config/boards/shields/nicenanosinc/Kconfig.defconfig
```kconfig
if SHIELD_NICENANOSINC

config ZMK_KEYBOARD_NAME
    default "nice!nanoSinc"

endif
```

## config/boards/shields/nicenanosincsplit/Kconfig.defconfig
```kconfig
if SHIELD_NICENANOSINCSPLIT_LEFT

config ZMK_KEYBOARD_NAME
	default "n!nSinc Split"

config ZMK_SPLIT_BLE_ROLE_CENTRAL
	default y

endif

if SHIELD_NICENANOSINCSPLIT_RIGHT

config ZMK_KEYBOARD_NAME
	default "n!nSinc Right"

endif

if SHIELD_NICENANOSINCSPLIT_LEFT || SHIELD_NICENANOSINCSPLIT_RIGHT

config ZMK_SPLIT
	default y

endif
```

## config/boards/shields/nicenanosincsplit/Kconfig.shield
```kconfig
config SHIELD_NICENANOSINCSPLIT_LEFT
	def_bool $(shields_list_contains,nicenanosincsplit_left)

config SHIELD_NICENANOSINCSPLIT_RIGHT
	def_bool $(shields_list_contains,nicenanosincsplit_right)
```

## config/boards/shields/soflergb/Kconfig.shield
```kconfig
# Copyright (c) 2020 Ryan Cross
# SPDX-License-Identifier: MIT

config SHIELD_SOFLERGB_LEFT
	def_bool $(shields_list_contains,soflergb_left)

config SHIELD_SOFLERGB_RIGHT
	def_bool $(shields_list_contains,soflergb_right)
```

## config/boards/shields/viterbi/Kconfig.shield
```kconfig
config SHIELD_VITERBI_LEFT
	def_bool $(shields_list_contains,viterbi_left)

config SHIELD_ERGO42_RIGHT
	def_bool $(shields_list_contains,viterbi_right)
```
