#include "nicenanosincsplit.dtsi"

&default_transform {
	col-offset = <7>;
};

&kscan0 {
	col-gpios
		= <&pro_micro_d 9 GPIO_ACTIVE_HIGH> // gpio1  6
		, <&pro_micro_d	8 GPIO_ACTIVE_HIGH> // gpio1  4
		, <&pro_micro_d	7 GPIO_ACTIVE_HIGH> // gpio0 11
		, <&pro_micro_d	6 GPIO_ACTIVE_HIGH> // gpio1  0
		, <&pro_micro_d 5 GPIO_ACTIVE_HIGH> // gpio0 24
		, <&pro_micro_d	4 GPIO_ACTIVE_HIGH> // gpio0 22
		, <&pro_micro_d 3 GPIO_ACTIVE_HIGH> // gpio0 20
		, <&pro_micro_d 2 GPIO_ACTIVE_HIGH> // gpio0 17
		, <&pro_micro_d 0 GPIO_ACTIVE_HIGH> // gpio0  8
		;			
	row-gpios
		= <&pro_micro_d 10 (GPIO_ACTIVE_HIGH | GPIO_PULL_DOWN)> // gpio0  9
		, <&pro_micro_d	16 (GPIO_ACTIVE_HIGH | GPIO_PULL_DOWN)> // gpio0 10
		, <&pro_micro_d	14 (GPIO_ACTIVE_HIGH | GPIO_PULL_DOWN)> // gpio1 11
		, <&pro_micro_d	15 (GPIO_ACTIVE_HIGH | GPIO_PULL_DOWN)> // gpio1 13
		, <&pro_micro_a  0 (GPIO_ACTIVE_HIGH | GPIO_PULL_DOWN)> // gpio1 15
		, <&pro_micro_a  1 (GPIO_ACTIVE_HIGH | GPIO_PULL_DOWN)> // gpio0  2
		;        
};
