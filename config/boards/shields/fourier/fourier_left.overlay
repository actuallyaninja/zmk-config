#include "fourier.dtsi"

&kscan0 {	
	col-gpios
		= <&pro_micro_a  2 GPIO_ACTIVE_HIGH> // &gpio0 29
		, <&pro_micro_a  1 GPIO_ACTIVE_HIGH> // &gpio0  2
		, <&pro_micro_a  0 GPIO_ACTIVE_HIGH> // &gpio1 15
		, <&pro_micro_d	15 GPIO_ACTIVE_HIGH> // &gpio1 13
		, <&pro_micro_d	14 GPIO_ACTIVE_HIGH> // &gpio1 11
		, <&pro_micro_d	16 GPIO_ACTIVE_HIGH> // &gpio0 10
		, <&pro_micro_d	10 GPIO_ACTIVE_HIGH> // &gpio0  9			      
		;		
	row-gpios
		= <&pro_micro_a 3 (GPIO_ACTIVE_HIGH | GPIO_PULL_DOWN)> // &gpio0 31
		, <&pro_micro_d	6 (GPIO_ACTIVE_HIGH | GPIO_PULL_DOWN)> // &gpio1  0
		, <&pro_micro_d	7 (GPIO_ACTIVE_HIGH | GPIO_PULL_DOWN)> // &gpio0 11
		, <&pro_micro_d	8 (GPIO_ACTIVE_HIGH | GPIO_PULL_DOWN)> // &gpio1  4
		;
};
